/*LLLLLLLLLLLLLLLLLLLLLLLLLLLLLLLLLLLLLLLLLLLLLLLLLLLLLLLLLLLLLL
【平    台】北京龙邱智能科技TC264DA核心板
【编    写】ZYF/chiusir
【E-mail  】chiusir@163.com
【软件版本】V1.1 版权所有，单位使用请先联系授权
【最后更新】2020年4月10日
【相关信息参考下列地址】
【网    站】http://www.lqist.cn
【淘宝店铺】http://longqiu.taobao.com
------------------------------------------------
【dev.env.】Hightec4.9.3/Tasking6.3及以上版本
【Target 】 TC264DA
【Crystal】 20.000Mhz
【SYS PLL】 200MHz
________________________________________________________________

QQQQQQQQQQQQQQQQQQQQQQQQQQQQQQQQQQQQQQQQQQQQQQQQQQQQQQQQQQQQQQQ*/

#include <LQ_GPIO.h>
#include <LQ_GPIO_LED.h>
#include <LQ_STM.h>
#include <LQ_TFT18.h>
#include <LQ_TFT18Pic.h>
#include <Platform_Types.h>
#include <stdio.h>

//龙邱TFT SPI口模块管脚顺序
#define TFTSPI_CS       P20_14     // CS管脚 默认拉低，可以不用
#define TFTSPI_SCK      P20_11     // SPI SCK管脚
#define TFTSPI_SDI      P20_10     // SPI MOSI管脚
#define TFTSPI_DC       P20_12     // D/C管脚
#define TFTSPI_RST      P20_13     // RESET管脚

#include <LQ_QSPI.h>
#include <LQ_SPI.h>
#define USE_QSPI  0     //不使用硬件SPI接线方式    如果使用硬件SPI  则CS接P21_2  SCK接P00_2   SDI接P00_1  DC接P20_12  RST接P20_13

/**
  * @brief    不精确延时
  *
  * @param    无
  *
  * @return   无
  *
  * @note     无
  *
  * @see      lq_tft_delayms(100);
  *
  * @date     2019/4/22 星期一
*/
static void lq_tft_delayms(uint16_t ms)
{
	volatile uint32_t i = 0;
	while(ms--)
	{
		for (i = 0; i < 15000; ++i)
		{
			__asm("NOP"); /* delay */
		}
	}
}





#define TFTSPI_CS_H     PIN_Write(TFTSPI_CS, 1);      /*!< CS管脚 */
#define TFTSPI_SCK_H    PIN_Write(TFTSPI_SCK, 1);     /*!< SCL管脚 */
#define TFTSPI_SDI_H    PIN_Write(TFTSPI_SDI, 1);     /*!< SDI管脚 */
#define TFTSPI_DC_H     PIN_Write(TFTSPI_DC, 1);      /*!< DC管脚 */
#define TFTSPI_RST_H    PIN_Write(TFTSPI_RST, 1);     /*!< RST管脚 */

#define TFTSPI_CS_L     PIN_Write(TFTSPI_CS, 0);     /*!< CS管脚 */
#define TFTSPI_SCK_L    PIN_Write(TFTSPI_SCK, 0);    /*!< SCL管脚 */
#define TFTSPI_SDI_L    PIN_Write(TFTSPI_SDI, 0);    /*!< SDI管脚 */
#define TFTSPI_DC_L     PIN_Write(TFTSPI_DC, 0);     /*!< DC管脚 */
#define TFTSPI_RST_L    PIN_Write(TFTSPI_RST, 0);    /*!< RST管脚 */

/*!
  * @brief    TFT18初始化
  *
  * @param    type ： 0:横屏  1：竖屏
  *
  * @return   无
  *
  * @note     如果修改管脚 需要修改初始化的管脚
  *
  * @see      TFTSPI_Init(1);
  *
  * @date     2019/6/13 星期四
  */
void TFTSPI_Init(uint8_t type)
{
  //-----端口初始化----//
	PIN_InitConfig(TFTSPI_CS,  PIN_MODE_OUTPUT, 0);
	PIN_InitConfig(TFTSPI_DC,  PIN_MODE_OUTPUT, 0);
	PIN_InitConfig(TFTSPI_RST, PIN_MODE_OUTPUT, 0);

#if USE_QSPI
	SPI_InitConfig(SPI3_CLK_P00_2, SPI3_MISO_NULL, SPI3_MOSI_P00_1, SPI3_CS_P21_2, 10000000);
//	QSPI_InitConfig(QSPI0_CLK_P20_11, QSPI_MISO_NULL, QSPI0_MOSI_P20_12, QSPI0_CS_P15_0, 15000000, 3);

#else
	PIN_InitConfig(TFTSPI_SCK, PIN_MODE_OUTPUT, 0);
	PIN_InitConfig(TFTSPI_SDI, PIN_MODE_OUTPUT, 0);

#endif


	TFTSPI_RST_L;
    lq_tft_delayms(50);
    TFTSPI_RST_H;
	lq_tft_delayms(50);
	TFTSPI_Write_Cmd(0x11);       		  	//关闭睡眠，振荡器工作
	lq_tft_delayms(10);
	TFTSPI_Write_Cmd(0x3a);       		  	//每次传送16位数据(VIPF3-0=0101)，每个像素16位(IFPF2-0=101)
	TFTSPI_Write_Byte(0x55);
	TFTSPI_Write_Cmd(0x26);
	TFTSPI_Write_Byte(0x04);
	TFTSPI_Write_Cmd(0xf2);              		//Driver Output Control(1)
	TFTSPI_Write_Byte(0x01);
	TFTSPI_Write_Cmd(0xe0);              		//Driver Output Control(1)
	TFTSPI_Write_Byte(0x3f);
	TFTSPI_Write_Byte(0x25);
	TFTSPI_Write_Byte(0x1c);
	TFTSPI_Write_Byte(0x1e);
	TFTSPI_Write_Byte(0x20);
	TFTSPI_Write_Byte(0x12);
	TFTSPI_Write_Byte(0x2a);
	TFTSPI_Write_Byte(0x90);
	TFTSPI_Write_Byte(0x24);
	TFTSPI_Write_Byte(0x11);
	TFTSPI_Write_Byte(0x00);
	TFTSPI_Write_Byte(0x00);
	TFTSPI_Write_Byte(0x00);
	TFTSPI_Write_Byte(0x00);
	TFTSPI_Write_Byte(0x00);
	TFTSPI_Write_Cmd(0xe1);              //Driver Output Control(1)
	TFTSPI_Write_Byte(0x20);
	TFTSPI_Write_Byte(0x20);
	TFTSPI_Write_Byte(0x20);
	TFTSPI_Write_Byte(0x20);
	TFTSPI_Write_Byte(0x05);
	TFTSPI_Write_Byte(0x00);
	TFTSPI_Write_Byte(0x15);
	TFTSPI_Write_Byte(0xa7);
	TFTSPI_Write_Byte(0x3d);
	TFTSPI_Write_Byte(0x18);
	TFTSPI_Write_Byte(0x25);
	TFTSPI_Write_Byte(0x2a);
	TFTSPI_Write_Byte(0x2b);
	TFTSPI_Write_Byte(0x2b);
	TFTSPI_Write_Byte(0x3a);
	TFTSPI_Write_Cmd(0xb1);      //0xb1      	//设置屏幕刷新频率
	TFTSPI_Write_Byte(0x00);     //0x08		//DIVA=8
	TFTSPI_Write_Byte(0x00);	    //0x08		//VPA =8，约90Hz
	TFTSPI_Write_Cmd(0xb4);              	//LCD Driveing control
	TFTSPI_Write_Byte(0x07);			//NLA=1,NLB=1,NLC=1
	TFTSPI_Write_Cmd(0xc0);              //LCD Driveing control  Power_Control1
	TFTSPI_Write_Byte(0x0a);
	TFTSPI_Write_Byte(0x02);
	TFTSPI_Write_Cmd(0xc1);              //LCD Driveing control
	TFTSPI_Write_Byte(0x02);
	TFTSPI_Write_Cmd(0xc5);              //LCD Driveing control
	TFTSPI_Write_Byte(0x4f);
	TFTSPI_Write_Byte(0x5a);
	TFTSPI_Write_Cmd(0xc7);              //LCD Driveing control
	TFTSPI_Write_Byte(0x40);
	TFTSPI_Write_Cmd(0x2a);              //配置MCU可操作的LCD内部RAM横坐标起始、结束参数
	TFTSPI_Write_Byte(0x00);		//横坐标起始地址0x0000
	TFTSPI_Write_Byte(0x00);
	TFTSPI_Write_Byte(0x00);		//横坐标结束地址0x007f(127)
	TFTSPI_Write_Byte(0xa8);                //7f
	TFTSPI_Write_Cmd(0x2b);              //配置MCU可操作的LCD内部RAM纵坐标起始结束参数
	TFTSPI_Write_Byte(0x00);		//纵坐标起始地址0x0000
	TFTSPI_Write_Byte(0x00);
	TFTSPI_Write_Byte(0x00);		//纵坐标结束地址0x009f(159)
	TFTSPI_Write_Byte(0xb3);                //9f
	TFTSPI_Write_Cmd(0x36);              //配置MPU和DDRAM对应关系
	if(type)
	TFTSPI_Write_Byte(0xC0);                //竖屏显示          //MX=1,MY=1
	else
	TFTSPI_Write_Byte(0xA0);            	  //横屏显示

	TFTSPI_Write_Cmd(0xb7);              //LCD Driveing control
	TFTSPI_Write_Byte(0x00);		       //CRL=0
	TFTSPI_Write_Cmd(0x29);   		   //开启屏幕显示
	TFTSPI_Write_Cmd(0x2c);   		   //设置为LCD接收数据/命令模式
}

/*!
  * @brief    简单延时函数
  *
  * @param    Del ：延时时间
  *
  * @return   无
  *
  * @note     内部调用
  *
  * @see      tft18delay_1us(1);
  *
  * @date     2019/6/13 星期四
  */
void tft18delay_1us(unsigned int Del)		//
{
  while(Del--)
  {
    __asm("NOP");
  }
}

#if USE_QSPI
/*!
  * @brief    写命令
  *
  * @param    cmd ：命令
  *
  * @return   无
  *
  * @note     内部调用
  *
  * @see      TFTSPI_Write_Cmd(0xb7); //LCD Driveing control
  *
  * @date     2019/6/13 星期四
  */
void TFTSPI_Write_Cmd(uint8_t cmd)
{

  TFTSPI_DC_L;// A0=0 ILI9163_A0=0;	 //A0=0发送命令

//  QSPI_ReadWriteNByte(QSPI0, &cmd, &cmd, 1);
  SPI_ReadWriteNByte(SPI3, &cmd, &cmd, 1);


}

/*!
  * @brief    写字节
  *
  * @param    dat ：数据
  *
  * @return   无
  *
  * @note     内部调用
  *
  * @see      TFTSPI_Write_Byte(0x00);	//CRL=0
  *
  * @date     2019/6/13 星期四
  */
void TFTSPI_Write_Byte(uint8_t dat)
{

  TFTSPI_DC_H;// A0=1  ILI9163_A0=1;		  //A0=1发送数据

//  QSPI_ReadWriteNByte(QSPI0, &dat, &dat, 1);
  SPI_ReadWriteNByte(SPI3, &dat, &dat, 1);

}

/*!
  * @brief    写半字
  *
  * @param    dat ：数据
  *
  * @return   无
  *
  * @note     无
  *
  * @see      TFTSPI_Write_Word(0xFFFF);
  *
  * @date     2019/6/13 星期四
  */
void TFTSPI_Write_Word(uint16_t dat)
{

  TFTSPI_DC_H;// A0=1  ILI9163_A0=1;

  uint8 buff[2];
  buff[0] = dat >> 8;
  buff[1] = (uint8)dat;

//  QSPI_ReadWriteNByte(QSPI0, buff , buff, 2);

  SPI_ReadWriteNByte(SPI3, buff, buff, 2);

}

#else

/*!
  * @brief    写命令
  *
  * @param    cmd ：命令
  *
  * @return   无
  *
  * @note     内部调用
  *
  * @see      TFTSPI_Write_Cmd(0xb7); //LCD Driveing control
  *
  * @date     2019/6/13 星期四
  */
void TFTSPI_Write_Cmd(uint8_t cmd)
{
  uint8_t i;

  TFTSPI_DC_L;// A0=0 ILI9163_A0=0;	 //A0=0发送命令

  for(i=0;i<8;i++)
  {
    TFTSPI_SCK_L;tft18delay_1us(1);	// SCK=0  ILI9163_SCK=0;
    if(cmd&0x80){TFTSPI_SDI_H;}// SDI=1
    else{TFTSPI_SDI_L;}// SDI=0
    TFTSPI_SCK_H;tft18delay_1us(1);	// SCK=1  ILI9163_SCK = 1;
    cmd = (cmd<<1);
  }
}

/*!
  * @brief    写字节
  *
  * @param    dat ：数据
  *
  * @return   无
  *
  * @note     内部调用
  *
  * @see      TFTSPI_Write_Byte(0x00);	//CRL=0
  *
  * @date     2019/6/13 星期四
  */
void TFTSPI_Write_Byte(uint8_t dat)
{
  uint8_t i;

  TFTSPI_DC_H;// A0=1  ILI9163_A0=1;		  //A0=1发送数据

  for(i=0;i<8;i++)
  {
    TFTSPI_SCK_L;tft18delay_1us(1);	// SCK=0  ILI9163_SCK=0;
    if(dat&0x80){TFTSPI_SDI_H;}// SDI=1
    else{TFTSPI_SDI_L;}// SDI=0
    TFTSPI_SCK_H;tft18delay_1us(1);	// SCK=1 ILI9163_SCK = 1;
    dat = (dat<<1);
  }
}

/*!
  * @brief    写半字
  *
  * @param    dat ：数据
  *
  * @return   无
  *
  * @note     无
  *
  * @see      TFTSPI_Write_Word(0xFFFF);
  *
  * @date     2019/6/13 星期四
  */
void TFTSPI_Write_Word(uint16_t dat)
{
  uint8_t i;


  TFTSPI_DC_H;// A0=1  ILI9163_A0=1;

  for(i=0;i<16;i++)
  {
    TFTSPI_SCK_L;tft18delay_1us(1);	// SCK=0  ILI9163_SCK=0;
    if(dat&0x8000){ TFTSPI_SDI_H;}// SDI=1
    else{TFTSPI_SDI_L;}// SDI=0
    TFTSPI_SCK_H;tft18delay_1us(1);	// SCK=1  ILI9163_SCK=1;
    dat<<=1;
  }
}

#endif

/*!
  * @brief    重新定位输入信息位置
  *
  * @param    xs ：起始x
  * @param    ys ：起始y
  * @param    xe ：结束x
  * @param    ys ：结束y
  *
  * @return   无
  *
  * @note     内部调用
  *
  * @see      TFTSPI_Set_Pos(10, 20, 30, 40);
  *
  * @date     2019/6/13 星期四
  */
void TFTSPI_Set_Pos(uint8_t xs,uint8_t ys,uint8_t xe,uint8_t ye)
{
  TFTSPI_Write_Cmd(0x2A);      	//Colulm addRSTs set
  TFTSPI_Write_Byte(0x00);		//行起始坐标高8位，始终为零
  TFTSPI_Write_Byte(xs);			//行起始坐标低8位
  TFTSPI_Write_Byte(0x00);		//行终止坐标高8位，始终为零
  TFTSPI_Write_Byte(xe);			//行终止坐标低8位  
  TFTSPI_Write_Cmd(0x2B);      	//Colulm addRSTs set
  TFTSPI_Write_Byte(0x00);		//列起始坐标高8位，始终为零
  TFTSPI_Write_Byte(ys);			//列起始坐标低8位
  TFTSPI_Write_Byte(0x00);		//列终止坐标高8位，始终为零
  TFTSPI_Write_Byte(ye);			//列终止坐标低8位  
  TFTSPI_Write_Cmd(0x2C);      	//GRAM接收MCU数据或命令
}


/*!
  * @brief    重置地址
  *
  * @param    无
  *
  * @return   无
  *
  * @note     内部调用
  *
  * @see      TFTSPI_Addr_Rst();
  *
  * @date     2019/6/13 星期四
  */
void TFTSPI_Addr_Rst(void)
{
  TFTSPI_Write_Cmd(0x2a);     //配置MCU可操作的LCD内部RAM横坐标起始、结束参数
  TFTSPI_Write_Byte(0x00);       //横坐标起始地址0x0000
  TFTSPI_Write_Byte(0x00);					
  TFTSPI_Write_Byte(0x00);       //横坐标结束地址0x007f(127)
  TFTSPI_Write_Byte(0xa8);       //7f  
  TFTSPI_Write_Cmd(0x2b);     //配置MCU可操作的LCD内部RAM纵坐标起始结束参数
  TFTSPI_Write_Byte(0x00);       //纵坐标起始地址0x0000
  TFTSPI_Write_Byte(0x00);
  TFTSPI_Write_Byte(0x00);       //纵坐标结束地址0x009f(159)
  TFTSPI_Write_Byte(0xb3);       //9f  
  TFTSPI_Write_Cmd(0x2C);     //GRAM接收MCU数据或命令
}


/*!
  * @brief    填充指定区域
  *
  * @param    xs ：起始x
  * @param    ys ：起始y
  * @param    xe ：结束x
  * @param    ys ：结束y
  * @param    color ：填充的颜色
  *
  * @return   无
  *
  * @note     起始、终止横坐标(0-127)，纵坐标(0-159),显示颜色uint16
  *
  * @see      TFTSPI_Fill_Area(10, 20, 30, 40, u16YELLOW);
  *
  * @date     2019/6/13 星期四
  */
void TFTSPI_Fill_Area(uint8_t xs,uint8_t ys,uint8_t xe,uint8_t ye,uint16_t color)
{
  unsigned int i,j;
  
  TFTSPI_Set_Pos(xs,ys,xe,ye);
  for(i=0;i<(xe-xs);i++)  
  {
    for(j=0;j<(ye-ys);j++)
    {
      TFTSPI_Write_Word(color);
    }
  }
}


/*!
  * @brief    全屏显示单色画面
  *
  * @param    color ：填充的颜色
  *
  * @return   无
  *
  * @note     起始、终止横坐标(0-127)，纵坐标(0-159),显示颜色uint16
  *
  * @see      TFTSPI_CLS(u16YELLOW);
  *
  * @date     2019/6/13 星期四
  */
void TFTSPI_CLS(uint16_t color)
{
  unsigned int i,j;
  
  TFTSPI_Addr_Rst();
  
  for(i=0;i<TFT18W;i++)      //160
  {
    for(j=0;j<TFT18H;j++)
    {
      TFTSPI_Write_Word(color);
    }
  }
}

/*!
  * @brief    填充矩形区域
  *
  * @param    xs ：起始x
  * @param    ys ：起始y
  * @param    xe ：结束x
  * @param    ys ：结束y
  * @param    color_dat ：填充的颜色
  *
  * @return   无
  *
  * @note     起始、终止横坐标(0-127)，纵坐标(0-159),显示颜色uint16
  *
  * @see      TFTSPI_Draw_Part(10, 20, 30, 40, u16YELLOW);
  *
  * @date     2019/6/13 星期四
  */
void TFTSPI_Draw_Part(uint8_t xs,uint8_t ys,uint8_t xe,uint8_t ye,uint16_t color_dat)
{
  uint8_t i,j;
  
  TFTSPI_Set_Pos(xs,ys,xe,ye);	
  for(j=0;j<(ye-ys+1);j++)
  {
    for(i=0;i<(xe-xs+1);i++)
    {
      TFTSPI_Write_Word(color_dat);
    }
  }   
}


/*!
  * @brief    画矩形边框
  *
  * @param    xs ：起始x
  * @param    ys ：起始y
  * @param    xe ：结束x
  * @param    ys ：结束y
  * @param    color_dat ：颜色
  *
  * @return   无
  *
  * @note     起始、终止横坐标(0-127)，纵坐标(0-159),显示颜色uint16
  *
  * @see      TFTSPI_Draw_Rectangle(10, 20, 30, 40, u16YELLOW);
  *
  * @date     2019/6/13 星期四
  */
void TFTSPI_Draw_Rectangle(uint8_t xs,uint8_t ys,uint8_t xe,uint8_t ye,uint16_t color_dat)
{
  TFTSPI_Draw_Line(xs,ys,xs,ye,color_dat);	  //画矩形左边
  TFTSPI_Draw_Line(xe,ys,xe,ye,color_dat);	  //画矩形右边
  TFTSPI_Draw_Line(xs,ys,xe,ys,color_dat);	  //画矩形上边
  TFTSPI_Draw_Line(xs,ye,xe,ye,color_dat);	  //画矩形下边
}


/*!
  * @brief    画圆
  *
  * @param    x ：圆心x   (0-127)
  * @param    y ：圆心y   (0-159)
  * @param    r ：半径    (0-128)
  * @param    color_dat ：颜色
  *
  * @return   无
  *
  * @note     圆心坐标不要超出屏幕范围
  *
  * @see      TFTSPI_Draw_Circle(50, 50, 30, u16YELLOW);
  *
  * @date     2019/6/13 星期四
  */
void TFTSPI_Draw_Circle(uint8_t x,uint8_t y,uint8_t r,uint16_t color_dat)
{
  unsigned char dx, dy = r; 
  
  if((x>=r) &&((TFT18W-x)>=r) && (y>=r) && ((TFT18H-y)>=r))		//确定所画圆在屏幕范围内，没有超出最外边，(暂不支持与屏幕边相交)
  {
    for(dx = 0; dx <= r; dx++)
    {
      while((r * r + 1 - dx * dx) < (dy * dy)) dy--;
      TFTSPI_Draw_Dot(x + dx, y - dy, color_dat);
      TFTSPI_Draw_Dot(x - dx, y - dy, color_dat);
      TFTSPI_Draw_Dot(x - dx, y + dy, color_dat);
      TFTSPI_Draw_Dot(x + dx, y + dy, color_dat);
      
      TFTSPI_Draw_Dot(x + dy, y - dx, color_dat);
      TFTSPI_Draw_Dot(x - dy, y - dx, color_dat);
      TFTSPI_Draw_Dot(x - dy, y + dx, color_dat);
      TFTSPI_Draw_Dot(x + dy, y + dx, color_dat);
    }
  }
}


/*!
  * @brief    画线
  *
  * @param    xs ：起始x
  * @param    ys ：起始y
  * @param    xe ：结束x
  * @param    ys ：结束y
  * @param    color_dat ：颜色
  *
  * @return   无
  *
  * @note     起始、终止横坐标(0-127)，纵坐标(0-159),显示颜色uint16
  *
  * @see      TFTSPI_Draw_Line(10, 20, 30, 40, u16YELLOW);
  *
  * @date     2019/6/13 星期四
  */
void TFTSPI_Draw_Line(uint8_t xs,uint8_t ys,uint8_t xe,uint8_t ye,uint16_t color_dat)
{
  int i,ds;
  int dx,dy,inc_x, inc_y;
  int xerr = 0, yerr = 0;				        //初始化变量
  
  if(xs==xe)	  						//如果是画垂直线则只需对竖直坐标计数
  {
    TFTSPI_Set_Pos(xs,ys,xe,ye);
    for(i=0;i<(ye-ys+1);i++)
    {
      TFTSPI_Write_Word(color_dat);
    }
  }
  else if(ys==ye)						//如果是水平线则只需要对水平坐标计数
  {
    TFTSPI_Set_Pos(xs,ys,xe,ye);
    for(i=0;i<(xe-xs+1);i++)
    {
      TFTSPI_Write_Word(color_dat);
    }
  } 
  else								//如果是斜线，则重新计算，使用画点函数画出直线
  {
    dx = xe - xs;						//计算坐标增量
    dy = ye - ys;
    
    if(dx > 0) inc_x = 1;					//设置单步方向
    else 
    {
      inc_x = -1; dx = -dx;
    }
    if(dy > 0) inc_y = 1;					//设置单步方向
    else
    {
      inc_y = -1; dy = -dy;
    }
    
    if(dx > dy) {ds = dx;}					//选取基本增量坐标轴
    else		{ds = dy;}
    
    for(i = 0; i <= ds+1; i++)					//画线输出
    {
      TFTSPI_Draw_Dot(xs, ys,color_dat);	//画点
      xerr += dx;
      yerr += dy;
      if(xerr > ds)
      {
        xerr -= ds;
        xs   += inc_x;
      }
      if(yerr > ds)
      {
        yerr -= ds;
        ys   += inc_y;
      }
    }
  }  
}

/*!
  * @brief    画点
  *
  * @param    x ：x
  * @param    y ：y
  * @param    color_dat ：颜色
  *
  * @return   无
  *
  * @note     起始、终止横坐标(0-127)，纵坐标(0-159),显示颜色uint16
  *
  * @see      TFTSPI_Draw_Dot(10, 20, u16YELLOW);
  *
  * @date     2019/6/13 星期四
  */
void TFTSPI_Draw_Dot(uint8_t x,uint8_t y,uint16_t color_dat)
{
  TFTSPI_Set_Pos(x,y,x,y);
  TFTSPI_Write_Word(color_dat);
}


/*!
  * @brief    显示图片
  *
  * @param    xs ：起始x
  * @param    ys ：起始y
  * @param    xe ：结束x
  * @param    ys ：结束y
  * @param    ppic ：图片数据
  *
  * @return   无
  *
  * @note     起始、终止横坐标(0-127)，纵坐标(0-159),显示颜色uint16
  *
  * @see
  *
  * @date     2019/6/13 星期四
  */
void TFTSPI_Show_Pic(uint8_t xs,uint8_t ys,uint8_t xe,uint8_t ye,const char *ppic)
{
  unsigned int i,j,k=0;
  
  TFTSPI_Set_Pos(xs,ys,xe-1,ye);
  for(i=0;i<ye-ys;i++)
  { 
    for(j=0;j<xe-xs;j++)
    {			
      TFTSPI_Write_Word(((uint16_t)ppic[k])<<8|ppic[k+1]);
      k++;  k++;
    }
  }    
}
/** 字库
字库码的引索
--------------------------------------------------------------
(0)  !(1)  "(2)  #(3)  $(4)  %(5)  &(6)  '(7)
((8)  )(9)  *(10) +(11) ,(12) -(13) .(14) /(15)
0(16) 1(17) 2(18) 3(19) 4(20) 5(21) 6(22) 7(23)
8(24) 9(25) :(26) ;(27) <(28) =(29) >(30) ?(31)
@(32) A(33) B(34) C(35) D(36) E(37) F(38) G(39)
H(40) I(41) J(42) K(43) L(44) M(45) N(46) O(47)
P(48) Q(49) R(50) S(51) T(52) U(53) V(54) W(55)
X(56) Y(57) Z(58) [(59) \(60) ](61) ^(62) _(63)
`(64) a(65) b(66) c(67) d(68) e(69) f(70) g(71)
h(72) i(73) j(74) k(75) l(76) m(77) n(78) o(79)
p(80) q(81) r(82) s(83) t(84) u(85) v(86) w(87)
x(88) y(89) z(90) {(91) |(92) }(93) ~(94)
--------------------------------------------------------------
字体:	  8*6字体
取码规则:	低位在前, 列行扫描, 阴码(1-亮, 0-灭)
查表方法: 要显示的ASCII码-32就可以得到字库码的指针 */
const unsigned char Font_code8[][6] = {
  {0x00,0x00,0x00,0x00,0x00,0x00},// (0)
  {0x00,0x00,0x00,0x4F,0x00,0x00},//!(1)
  {0x00,0x00,0x07,0x00,0x07,0x00},//"(2)
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  {0x00,0x1C,0x22,0x44,0x22,0x1C}};//爱心(132)   


/** 字库
字库码的引索
--------------------------------------------------------------
(0)  !(1)  "(2)  #(3)  $(4)  %(5)  &(6)  '(7)
((8)  )(9)  *(10) +(11) ,(12) -(13) .(14) /(15)
0(16) 1(17) 2(18) 3(19) 4(20) 5(21) 6(22) 7(23)
8(24) 9(25) :(26) ;(27) <(28) =(29) >(30) ?(31)
@(32) A(33) B(34) C(35) D(36) E(37) F(38) G(39)
H(40) I(41) J(42) K(43) L(44) M(45) N(46) O(47)
P(48) Q(49) R(50) S(51) T(52) U(53) V(54) W(55)
X(56) Y(57) Z(58) [(59) \(60) ](61) ^(62) _(63)
`(64) a(65) b(66) c(67) d(68) e(69) f(70) g(71)
h(72) i(73) j(74) k(75) l(76) m(77) n(78) o(79)
p(80) q(81) r(82) s(83) t(84) u(85) v(86) w(87)
x(88) y(89) z(90) {(91) |(92) }(93) ~(94)
--------------------------------------------------------------
字体:	  GulimChe12 8*16字体
取码规则:	低位在前, 列行扫描, 阴码(1-亮, 0-灭)
查表方法: 要显示的ASCII码-32就可以得到字库码的指针 */
const unsigned char Font_code16[][16] = {
  {0x00,0x00,0x00,0x00,0x00,0x00,0x00,0x00,0x00,0x00,0x00,0x00,0x00,0x00,0x00,0x00},// (0)
  {0x00,0x00,0x10,0x10,0x10,0x10,0x10,0x10,0x10,0x10,0x00,0x00,0x10,0x10,0x00,0x00},//!(1)
  {0x00,0x00,0x24,0x24,0x24,0x24,0x00,0x00,0x00,0x00,0x00,0x00,0x00,0x00,0x00,0x00},//"(3)
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  {0x00,0x00,0x00,0x00,0x00,0x00,0x8C,0x72,0x00,0x00,0x00,0x00,0x00,0x00,0x00,0x00},
};	

/* MDK AC6编译器不支持 GB3212编码的中文 因此会出现警告 不影响正常使用 忽略即可 */
/** 简单的汉字字库 */
const unsigned char hanzi_Idx[] =
{     
  "北京龙邱丘智能科技淘宝店液晶单片机智能车器人启动中电压量不足请稍候，！：℃攻击娱乐模式普通格斗对话俯卧撑倒立握手敬礼跳舞蹈运动蓝精灵太极街舞温度—"
};

/** 14*16 简单的汉字字库*/
const unsigned char hanzi[] = {
  //取码规则:	高位在前, 行扫描, 阴码(1-亮, 0-灭)
  //查表方法: 要显示的ASCII码-32就可以得到字库码的指针 微软雅黑16*12    ° 
  0x00,0x00,0x00,0x00,0x08,0x80,0x08,0x80,0x08,0x8C,0xF8,0xF0,
  0x08,0x80,0x08,0x80,0x38,0x84,0xC8,0x84,0x08,0xF8,0x00,0x00,//北0
  0x00,0x00,0x00,0x00,0x03,0x00,0xFF,0xFC,0x3F,0xF0,0x20,0x10,
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  0x3F,0xF0,0x01,0x00,0x01,0x00,0xFF,0xFC,0x01,0x00,0x01,0x00,//车19	   	
};

/** 16*16 简单的汉字字库*/
const unsigned char hanzi16x16[] = {
  //列行式 14*16
  0x04,0x40,0x04,0x40,0x04,0x40,0x04,0x44,0x04,0x48,0x7C,0x50,0x04,0x60,0x04,0x40,
  0x04,0x40,0x04,0x40,0x04,0x40,0x04,0x42,0x1C,0x42,0xE4,0x42,0x44,0x3E,0x04,0x00,//北,0
  0x02,0x00,0x01,0x00,0xFF,0xFE,0x00,0x00,0x00,0x00,0x1F,0xF0,0x10,0x10,0x10,0x10,
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  0x00,0x00,0x00,0x00,0x00,0x00,0x00,0x00,0x00,0x00,0x00,0x00,0x00,0x00,0x00,0x00,// [空格] ,   
};


/*!
  * @brief    液晶字符输出(6*8字体)
  *
  * @param    x: 0 - 20	(行)
  * @param    y: 0 - 19	(列)
  * @param    word_color: 字体颜色
  * @param    back_color: 背景颜色
  *
  * @return   无
  *
  * @note     内部调用
  *
  * @see
  *
  * @date     2019/6/13 星期四
  */
void TFTSPI_P6X8(uint8_t x, uint8_t y, uint8_t c_dat,uint16_t word_color,uint16_t back_color)
{
  uint8_t i,j;

  TFTSPI_Set_Pos(x*6,y*8,(x+1)*6-1,(y+1)*8-1);			//定位字符显示区域
  
  for(j=0; j<8; j++)
  {
    for(i=0; i<6; i++)
    {
      if((Font_code8[c_dat-32][i]) & (0x01<<j))
        TFTSPI_Write_Word(word_color);
      else
        TFTSPI_Write_Word(back_color);
    }
  }
}

/*!
  * @brief    液晶字符输出(8*8字体)
  *
  * @param    x:0 - 15	(行)
  * @param    y:0 - 19	(列)
  * @param    word_color: 字体颜色
  * @param    back_color: 背景颜色
  *
  * @return   无
  *
  * @note     内部调用
  *
  * @see      TFTSPI_P8X8(1, 1, "123456", u16YELLOW, u16RED);
  *
  * @date     2019/6/13 星期四
  */
void TFTSPI_P8X8(uint8_t x, uint8_t y, uint8_t c_dat,uint16_t word_color,uint16_t back_color)
{
  uint8_t i,j;
  
  TFTSPI_Set_Pos(x*8,y*8,(x+1)*8-1,(y+1)*8-1);			//定位字符显示区域
  
  for(j=0; j<8; j++)
  {
    TFTSPI_Write_Word(back_color);
    for(i=0; i<6; i++)
    {
      if((Font_code8[c_dat-32][i]) & (0x01<<j))
        TFTSPI_Write_Word(word_color);
      else
        TFTSPI_Write_Word(back_color);
    }
    TFTSPI_Write_Word(back_color);
  }
}

/*!
  * @brief    液晶字符输出(8*16字体)
  *
  * @param    x: 0 -15   (行)
  * @param    y: 0 -9  	 (列)
  * @param    word_color: 字体颜色
  * @param    back_color: 背景颜色
  *
  * @return   无
  *
  * @note     内部调用
  *
  * @see
  *
  * @date     2019/6/13 星期四
  */
void TFTSPI_P8X16(uint8_t x, uint8_t y, uint8_t c_dat,uint16_t word_color,uint16_t back_color)
{
  uint8_t i,j;
  
  TFTSPI_Set_Pos(x*8,y*16,(x+1)*8-1,(y+1)*16-1);			//定位字符显示区域
  
  for(j=0; j <16; j++)
  {
    for(i=0; i<8; i++)
    {
      if((Font_code16[c_dat-32][j]) & (0x01<<i))
        TFTSPI_Write_Word(word_color);
      else
        TFTSPI_Write_Word(back_color);
    }
  }
}

/*!
  * @brief    液晶字符串输出(6*8字体)
  *
  * @param    x: 0 - 20 (行)
  * @param    y: 0 - 19 (列)
  * @param    word_color: 字体颜色
  * @param    back_color: 背景颜色
  *
  * @return   无
  *
  * @note     无
  *
  * @see      TFTSPI_P6X8Str(1, 1, "123456", u16YELLOW, u16RED);
  *
  * @date     2019/6/13 星期四
  */
void TFTSPI_P6X8Str(uint8_t x, uint8_t y, char *s_dat,uint16_t word_color,uint16_t back_color)
{
  while(*s_dat) TFTSPI_P6X8(x++, y, *s_dat++,word_color,back_color);
}


/*!
  * @brief    液晶字符串输出(8*8字体)
  *
  * @param    x:0 - 15 (行)
  * @param    y:0 - 19 (列)
  * @param    word_color: 字体颜色
  * @param    back_color: 背景颜色
  *
  * @return   无
  *
  * @note     无
  *
  * @see      TFTSPI_P8X8Str(1, 1, "123456", u16YELLOW, u16RED);
  *
  * @date     2019/6/13 星期四
  */
void TFTSPI_P8X8Str(uint8_t x, uint8_t y, char *s_dat,uint16_t word_color,uint16_t back_color)
{
  while(*s_dat) TFTSPI_P8X8(x++, y, *s_dat++,word_color,back_color);
}

/*!
  * @brief    液晶字符串输出(8*16字体)
  *
  * @param    x: x: 0 -15   (行)
  * @param    y: y: 0 -9  	 (列)
  * @param    word_color: 字体颜色
  * @param    back_color: 背景颜色
  *
  * @return   无
  *
  * @note     无
  *
  * @see      TFTSPI_P8X16Str(1, 1, "123456", u16YELLOW, u16RED);
  *
  * @date     2019/6/13 星期四
  */
void TFTSPI_P8X16Str(uint8_t x, uint8_t y, char *s_dat,uint16_t word_color,uint16_t back_color)
{
  while(*s_dat) TFTSPI_P8X16(x++, y, *s_dat++,word_color,back_color);
}


/*!
  * @brief    液晶汉字字符串输出(12*16字体)
  *
  * @param    x: 0 - 7	(行)
  * @param    y: 0 -12	(列)
  * @param    word_color: 字体颜色
  * @param    back_color: 背景颜色
  *
  * @return   无
  *
  * @note     汉字只能是字库里的 字库没有的需要自行添加
  *
  * @see      TFTSPI_P16x12Str(1, 1, "123456", u16YELLOW, u16RED);
  *
  * @date     2019/6/13 星期四
  */
void TFTSPI_P16x12Str(uint8_t x, uint8_t y, char *s_dat,uint16_t word_color,uint16_t back_color)
{
  unsigned char wm=0,ii = 0,i,j;
  unsigned int adder=1; 

  while(s_dat[ii] != '\0')
  {
    wm = 0;
    adder = 1;
    while(hanzi_Idx[wm] > 127)
    {
      if(hanzi_Idx[wm] == (uint8)s_dat[ii])
      {
        if(hanzi_Idx[wm + 1] == s_dat[ii + 1])
        {
          adder = wm * 12;
          break;
        }
      }
      wm += 2;			
    }
    
    if(adder != 1)// 显示汉字					
    {
      TFTSPI_Set_Pos(x*16,y*12,(x+1)*16-1,(y+1)*12-1);			//定位字符显示区域 			
      for(j=0; j <24; j++)
      {
        for(i=0; i<8; i++)
        {
          if((hanzi[adder]) &  (0x80>>i))
            TFTSPI_Write_Word(word_color);
          else
            TFTSPI_Write_Word(back_color);
        }
        adder += 1;		 	
      } 					
    }
    else			  //显示空白字符			
    {}
    //y+=1;//左右方向
    x+=1;//上下方向  		  	
    ii += 2;
  }

}


/*!
  * @brief    液晶汉字字符串输出(16*16字体)
  *
  * @param    x: 0 - 7	(行)
  * @param    y: 0 - 9	(列)
  * @param    word_color: 字体颜色
  * @param    back_color: 背景颜色
  *
  * @return   无
  *
  * @note     汉字只能是字库里的 字库没有的需要自行添加
  *
  * @see      TFTSPI_P16x16Str(1, 1, "123456", u16YELLOW, u16RED);
  *
  * @date     2019/6/13 星期四
  */
void TFTSPI_P16x16Str(uint8_t x, uint8_t y, char *s_dat,uint16_t word_color,uint16_t back_color)
{
  unsigned char wm=0,ii = 0,i,j;
  int adder=1;
  
  while(s_dat[ii] != '\0')
  {
    wm = 0;
    adder = 1;
    while(hanzi_Idx[wm] > 127)
    {
      if(hanzi_Idx[wm] == (uint8)s_dat[ii])
      {
        if(hanzi_Idx[wm + 1] == s_dat[ii + 1])
        {
          adder = wm * 16;
          break;
        }
      }
      wm += 2;			
    }
    
    if(adder != 1)// 显示汉字					
    {
      TFTSPI_Set_Pos(x*16,y*16,(x+1)*16-1,(y+1)*16-1);			//定位字符显示区域 			
      for(j=0; j <32; j++)
      {
        for(i=0; i<8; i++)
        {
          if((hanzi16x16[adder]) &  (0x80>>i))
            TFTSPI_Write_Word(word_color);
          else
            TFTSPI_Write_Word(back_color);
        }
        adder += 1;		 	
      } 					
    }
    else			  //显示空白字符			
    {}
    //y+=1;//左右方向
    x+=1;//上下方向  		  	
    ii += 2;
  }
}






/*!
  * @brief    显示图片
  *
  * @param    xs ：起始x
  * @param    ys ：起始y
  * @param    xe ：结束x
  * @param    ys ：结束y
  * @param    ppic ：图片数据
  *
  * @return   无
  *
  * @note     起始、终止横坐标(0-127)，纵坐标(0-159),显示颜色uint16
  *
  * @see
  *
  * @date     2019/6/13 星期四
  */
void TFTSPI_Show_Pic2(uint8_t xs,uint8_t ys,uint8_t w,uint8_t h,const char *ppic)
{
    unsigned int i;
    TFTSPI_Set_Pos(xs,ys,xs+w-1,ys+h);
    for(i=0;i<w*h;i++)
    {
        TFTSPI_Write_Word((ppic[2*i]<<8)+(ppic[2*i+1])); //高位在前，且两个数据组合成一个16位数据表示像素值
    }
}

/*!
  * @brief    显示电池图标
  *
  * @param    无
  *
  * @return   无
  *
  * @note     无
  *
  * @see      TFTSPI_Show_Battery_Icon();
  *
  * @date     2019/6/13 星期四
  */
void TFTSPI_Show_Battery_Icon(void)
{
    TFTSPI_Show_Pic2(138,2,20,10,gImage_Battery_S); //显示电池图标20*10像素
}

/*!
  * @brief    显示标签
  *
  * @param    无
  *
  * @return   无
  *
  * @note     无
  *
  * @see      TFTSPI_Show_Title();
  *
  * @date     2019/6/13 星期四
  */
void TFTSPI_Show_Title(void)
{
    TFTSPI_Show_Pic2(0,0,92,28,gImage_title2);
    TFTSPI_Draw_Line(0,24,160,24,u16BLACK);   //补齐分割线
}

/*!
  * @brief    显示龙邱LOG
  *
  * @param    无
  *
  * @return   无
  *
  * @note     无
  *
  * @see      TFTSPI_Show_Logo();
  *
  * @date     2019/6/13 星期四
  */
void TFTSPI_Show_Logo(uint8_t xs,uint8_t ys)
{
    TFTSPI_Show_Pic2(xs,ys,160,54,gImage_lo);       //80,gImage_ftflogo);     //
}


/*!
  * @brief    TFT18屏 unsigned char 灰度数据显示
  *
  * @param    high_start ： 显示图像开始位置
  * @param    wide_start ： 显示图像开始位置
  * @param    high ： 显示图像高度
  * @param    wide ： 显示图像宽度
  * @param    Pixle： 显示图像数据地址
  *
  * @return   无
  *
  * @note     注意 屏幕左上为 （0，0）
  *
  * @see
  *
  * @date     2019/12/3 星期二
  */
void TFTSPI_Road(unsigned char high_start, unsigned char wide_start, unsigned char high, unsigned char wide, unsigned char *Pixle)
{
	unsigned long i;
    /* 设置显示范围 */
    TFTSPI_Set_Pos(wide_start, high_start, wide_start - 1 + wide, high_start - 1 + high);
    unsigned short color;
    unsigned long temp = high * wide;
    /* 显示图像 */
    for(i = 0; i < temp; i++)
    {

            /* 将灰度转化为 RGB565 */
            color = (Pixle[i] >> 3) << 11;
            color |= (Pixle[i] >> 2) << 5;
            color |= Pixle[i] >> 3;
            /* 显示 */
            TFTSPI_Write_Word (color);
        }

}

/*!
  * @brief    TFT18屏 unsigned char 二值化数据显示
  *
  * @param    high_start ： 显示图像开始位置
  * @param    wide_start ： 显示图像开始位置
  * @param    high ： 显示图像高度
  * @param    wide ： 显示图像宽度
  * @param    Pixle： 显示图像数据地址
  *
  * @return   无
  *
  * @note     注意 屏幕左上为 （0，0）
  *
  * @see
  *
  * @date     2019/12/3 星期二
  */
void TFTSPI_BinRoad(unsigned char high_start, unsigned char wide_start, unsigned char high, unsigned char wide, unsigned char *Pixle)
{
	unsigned long i;
    /* 设置显示范围 */
    TFTSPI_Set_Pos(wide_start, high_start, wide_start - 1 + wide, high_start - 1 + high);

    unsigned long temp = high * wide;
    /* 显示图像 */
    for(i = 0; i < temp; i++)
    {
        if(Pixle[i])
        {
            /* 显示 */
            TFTSPI_Write_Word (0xffff);
        }
        else
        {
            /* 显示 */
            TFTSPI_Write_Word (0);
        }

    }

}

/////////////////////////////////////////////////////////////////////////////////////
//////////////////////////////////以下部分为功能测试/////////////////////////////////
/////////////////////////////////////////////////////////////////////////////////////





void Test_TFT18(void)
{ 

  TFTSPI_Init(0);        //LCD初始化  0:横屏  1：竖屏
  TFTSPI_CLS(u16BLUE);   //蓝色屏幕	
  TFTSPI_Show_Logo(0,37);//显示龙邱LOGO
  TFTSPI_P16x16Str(0,0,"北京龙邱智能科技",u16RED,u16BLUE);		//字符串显示
  TFTSPI_P8X16Str(0,1,"Long Qiu i.s.t.",u16WHITE,u16BLACK);		//字符串显示  
  delayms(1000);         //延时等待
  char txt[32];
  unsigned short count = 1;
  while(1)
  {
      sprintf(txt, "variate:%05d", count);                    //将变量填充到字符串的对应位置，并将字符串存放到txt[]中
      TFTSPI_P8X16Str(0, 6, txt, u16RED, u16BLUE);              //将txt中 内容显示出来
  	  LED_Ctrl(LED0,RVS);        //电平翻转,LED闪烁
	  delayms(500);              //延时等待
      count++;
   }
}//TEST()
